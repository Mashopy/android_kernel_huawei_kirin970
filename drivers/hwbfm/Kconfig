## drivers/hwbfm/Kconfig
```kconfig
#
# huawei device state monitor configuration
#

config HUAWEI_BFM
	bool "huawei BFM"
	depends on LOG_EXCEPTION
	default n
	help
	  If you say yes here you get support for huawei boot fail monitor solution.

config HW_BFMR_HISI
	bool "bfmr for hisi"
	depends on HUAWEI_BFM
	default n
	help
	  If you say yes here you get support for huawei bfmr solution on hisi.

config HW_BFMR_QCOM
	bool "bfmr for qcom"
	default n
	help
	  If you say yes here you get support for huawei bfmr solution on qcom.

config HW_BFMR_MTK
	bool "bfmr for mtk"
	default n
	help
	  If you say yes here you get support for huawei bfmr solution on mtk.

config USE_BOOTFAIL_RECOVERY_SOLUTION
    bool "use bootfail recovery solution"
	depends on HUAWEI_BFM
    default n
    help
      If you say yes here you get support for huawei bfmr solution
      
source "drivers/hwbfm/hwbfr/Kconfig"
```

## drivers/hwbfm/hwbfr/Kconfig
```kconfig
#
# Huawei boot fail recovery subsystem configuration
#

config USE_BOOTFAIL_RECOVERY_SOLUTION
        bool "Enable boot fail recovery subsystem"
	depends on HUAWEI_BFM
        default n
```
